/**
 * @cliArgs --device "MSPM0G351X" --part "Default" --package "LQFP-100(PZ)" --product "mspm0_sdk@2.02.00.05"
 * @versions {"tool":"1.21.0+3721"}
 */

/**
 * Import the modules used in this configuration.
 */
const GPIO          = scripting.addModule("/ti/driverlib/GPIO", {}, false);
const GPIO1         = GPIO.addInstance();
const NONMAIN       = scripting.addModule("/ti/driverlib/NONMAIN");
const SYSCTL        = scripting.addModule("/ti/driverlib/SYSCTL");
const ProjectConfig = scripting.addModule("/ti/project_config/ProjectConfig");

/**
 * Write custom configuration values to the imported modules.
 */
GPIO1.$name                         = "GPIO_GRP_0";
GPIO1.associatedPins[0].$name       = "PIN_0";
GPIO1.associatedPins[0].direction   = "INPUT";
GPIO1.associatedPins[0].pin.$assign = "PA18";

const Board = scripting.addModule("/ti/driverlib/Board", {}, false);

NONMAIN.nonmainWarning = true;
NONMAIN.cscExists      = true;
NONMAIN.flashBankSwap  = true;


ProjectConfig.genLinker  = false;
ProjectConfig.genStartup = false;
scripting.suppress("All four File Generation options must be enabled in order to guarantee Device Migration support\\. If an option is disabled, the user must manually configure that setting on its own file\\.", ProjectConfig);

/**
 * Pinmux solution for unlocked pins/peripherals. This ensures that minor changes to the automatic solver in a future
 * version of the tool will not impact the pinmux you originally saw.  These lines can be completely deleted in order to
 * re-solve from scratch.
 */
Board.peripheral.$suggestSolution          = "DEBUGSS";
Board.peripheral.swclkPin.$suggestSolution = "PA20";
Board.peripheral.swdioPin.$suggestSolution = "PA19";
SYSCTL.peripheral.$suggestSolution         = "SYSCTL";
